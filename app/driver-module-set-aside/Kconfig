## app/driver-module-set-aside/Kconfig
```kconfig
menu "Iomico Zephyr Course driver module drivers"
rsource "drivers/Kconfig"
endmenu
```

## app/driver-module/dts/bindings/nn,driver.yaml
```yaml
description: |
  Basic driver example for Iomico 2026 Zephyr course, lecture 6
compatible: "nn,driver"
include: base.yaml
```

## boards/mi-placa/board.yml
```yaml
board:
  name: mi-placa
  full_name: Mi placa basado en Nucleo WL55JC
  vendor: iomico_course_2026
  socs:
    - name: stm32wl55xx
```

## boards/nuestra-placa/board.yml
```yaml
board:
  name: nuestra-placa
  full_name: Nuestra placa basado en Nucleo WL55JC
  vendor: iomico_course_2026
  socs:
    - name: stm32wl55xx
```

## west.yml
```yaml
manifest:
  version: 1.0

  projects:
    - name: zephyr
      url: https://github.com/zephyrproject-rtos/zephyr
      revision: v4.2.0
      import:
        name-allowlist:
          - cmsis_6
          - hal_nxp
          - hal_stm32
          - hal_nordic
        path-prefix: deps

    - name: nn-custom-driver
      path: deps/modules/lib/nn-custom-driver
      revision: main
      url: https://github.com/ted-havelka-portfolio/nn-custom-driver
```
